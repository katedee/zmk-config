## config/west.yml
```yaml
manifest:
  remotes:
    # zmk official
    - name: zmkfirmware
      url-base: https://github.com/zmkfirmware
    # Extra module for battery indicator
    - name: caksoylar
      url-base: https://github.com/caksoylar
    # Case mode behavior module
    - name: msmaili
      url-base: https://github.com/MSmaili
    # OS-aware shortcut module
    - name: mentaldesk
      url-base: https://github.com/mentaldesk
  projects:
    - name: zmk
      remote: zmkfirmware
      revision: main
      import: app/west.yml
    - name: zmk-rgbled-widget
      remote: caksoylar
      revision: main
    - name: zmk-case-mode
      remote: msmaili
      revision: main
    - name: oskey
      remote: mentaldesk
      revision: main
  self:
    path: config
```
